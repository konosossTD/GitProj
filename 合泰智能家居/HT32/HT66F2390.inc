; HT66F2390.inc
;	This file contains the definition of registers for
;		Holtek HT66F2390 microcontroller.
;	Generated by HTFileParse.dll.
;	Do not modify manually.

IAR0	EQU	[00H]
R0	EQU	[00H]	;old style declaration, not recommended for use
MP0	EQU	[01H]
IAR1	EQU	[02H]
R1	EQU	[02H]	;old style declaration, not recommended for use
MP1L	EQU	[03H]
MP1H	EQU	[04H]
ACC	EQU	[05H]
PCL	EQU	[06H]
TBLP	EQU	[07H]
TBLH	EQU	[08H]
TBHP	EQU	[09H]
STATUS	EQU	[0AH]
PBP	EQU	[0BH]
IAR2	EQU	[0CH]
MP2L	EQU	[0DH]
MP2H	EQU	[0EH]
RSTFC	EQU	[0FH]
INTC0	EQU	[010H]
INTC1	EQU	[011H]
INTC2	EQU	[012H]
INTC3	EQU	[013H]
PA	EQU	[014H]
PAC	EQU	[015H]
PAPU	EQU	[016H]
PAWU	EQU	[017H]
PB	EQU	[018H]
PBC	EQU	[019H]
PBPU	EQU	[01AH]
PC	EQU	[01BH]
PCC	EQU	[01CH]
PCPU	EQU	[01DH]
PD	EQU	[01EH]
PDC	EQU	[01FH]
PDPU	EQU	[020H]
PE	EQU	[021H]
PEC	EQU	[022H]
PEPU	EQU	[023H]
PF	EQU	[024H]
PFC	EQU	[025H]
PFPU	EQU	[026H]
PG	EQU	[027H]
PGC	EQU	[028H]
PGPU	EQU	[029H]
PH	EQU	[02AH]
PHC	EQU	[02BH]
PHPU	EQU	[02CH]
PMPS	EQU	[02DH]
RSTC	EQU	[02EH]
VBGRC	EQU	[02FH]
MFI0	EQU	[033H]
MFI1	EQU	[034H]
MFI2	EQU	[035H]
MFI3	EQU	[036H]
MFI4	EQU	[037H]
MFI5	EQU	[038H]
INTEG	EQU	[039H]
SCC	EQU	[03AH]
HIRCC	EQU	[03BH]
HXTC	EQU	[03CH]
LXTC	EQU	[03DH]
WDTC	EQU	[03EH]
LVRC	EQU	[03FH]
LVDC	EQU	[040H]
EEAL	EQU	[041H]
EEAH	EQU	[042H]
EED	EQU	[043H]
CP0C	EQU	[044H]
CP1C	EQU	[045H]
PTM0C0	EQU	[046H]
PTM0C1	EQU	[047H]
PTM0DL	EQU	[048H]
PTM0DH	EQU	[049H]
PTM0AL	EQU	[04AH]
PTM0AH	EQU	[04BH]
PTM0RPL	EQU	[04CH]
PTM0RPH	EQU	[04DH]
STM0C0	EQU	[04EH]
STM0C1	EQU	[04FH]
STM0DL	EQU	[050H]
STM0DH	EQU	[051H]
STM0AL	EQU	[052H]
STM0AH	EQU	[053H]
STM0RP	EQU	[054H]
SLEDC0	EQU	[055H]
SLEDC1	EQU	[056H]
SLEDC2	EQU	[057H]
SLEDC3	EQU	[058H]
MDUWR0	EQU	[059H]
MDUWR1	EQU	[05AH]
MDUWR2	EQU	[05BH]
MDUWR3	EQU	[05CH]
MDUWR4	EQU	[05DH]
MDUWR5	EQU	[05EH]
MDUWCTRL	EQU	[05FH]
CP0VOS	EQU	[060H]
CP1VOS	EQU	[061H]
PSC0R	EQU	[063H]
TB0C	EQU	[064H]
TB1C	EQU	[065H]
PSC1R	EQU	[066H]
SADOL	EQU	[067H]
SADOH	EQU	[068H]
SADC0	EQU	[069H]
SADC1	EQU	[06AH]
SADC2	EQU	[06BH]
SIMC0	EQU	[06CH]
SIMC1	EQU	[06DH]
SIMD	EQU	[06EH]
SIMC2	EQU	[06FH]
SIMA	EQU	[06FH]
SIMTOC	EQU	[070H]
SPIAC0	EQU	[071H]
SPIAC1	EQU	[072H]
SPIAD	EQU	[073H]
FARL	EQU	[074H]
FARH	EQU	[075H]
FD0L	EQU	[076H]
FD0H	EQU	[077H]
FD1L	EQU	[078H]
FD1H	EQU	[079H]
FD2L	EQU	[07AH]
FD2H	EQU	[07BH]
FD3L	EQU	[07CH]
FD3H	EQU	[07DH]
SCOMC	EQU	[07FH]
CRCCR	EQU	[0100H]
CRCIN	EQU	[0101H]
CRCDL	EQU	[0102H]
CRCDH	EQU	[0103H]
IECC	EQU	[0106H]
U2SR	EQU	[010BH]
U2CR1	EQU	[010CH]
U2CR2	EQU	[010DH]
TXR_RXR2	EQU	[010EH]
BRG2	EQU	[010FH]
U0SR	EQU	[0110H]
U0CR1	EQU	[0111H]
U0CR2	EQU	[0112H]
TXR_RXR0	EQU	[0113H]
BRG0	EQU	[0114H]
U1SR	EQU	[0115H]
U1CR1	EQU	[0116H]
U1CR2	EQU	[0117H]
TXR_RXR1	EQU	[0118H]
BRG1	EQU	[0119H]
PTM1C0	EQU	[011AH]
PTM1C1	EQU	[011BH]
PTM1DL	EQU	[011CH]
PTM1DH	EQU	[011DH]
PTM1AL	EQU	[011EH]
PTM1AH	EQU	[011FH]
PTM1RPL	EQU	[0120H]
PTM1RPH	EQU	[0121H]
PTM2C0	EQU	[0122H]
PTM2C1	EQU	[0123H]
PTM2DL	EQU	[0124H]
PTM2DH	EQU	[0125H]
PTM2AL	EQU	[0126H]
PTM2AH	EQU	[0127H]
PTM2RPL	EQU	[0128H]
PTM2RPH	EQU	[0129H]
PTM3C0	EQU	[012AH]
PTM3C1	EQU	[012BH]
PTM3DL	EQU	[012CH]
PTM3DH	EQU	[012DH]
PTM3AL	EQU	[012EH]
PTM3AH	EQU	[012FH]
PTM3RPL	EQU	[0130H]
PTM3RPH	EQU	[0131H]
STM1C0	EQU	[0132H]
STM1C1	EQU	[0133H]
STM1DL	EQU	[0134H]
STM1DH	EQU	[0135H]
STM1AL	EQU	[0136H]
STM1AH	EQU	[0137H]
STM1RP	EQU	[0138H]
STM2C0	EQU	[0139H]
STM2C1	EQU	[013AH]
STM2DL	EQU	[013BH]
STM2DH	EQU	[013CH]
STM2AL	EQU	[013DH]
STM2AH	EQU	[013EH]
STM2RP	EQU	[013FH]
EEC	EQU	[0140H]
FC0	EQU	[0143H]
FC1	EQU	[0144H]
FC2	EQU	[0145H]
IFS0	EQU	[0148H]
IFS1	EQU	[0149H]
IFS2	EQU	[014AH]
IFS3	EQU	[014BH]
PAS0	EQU	[014DH]
PAS1	EQU	[014EH]
PBS0	EQU	[014FH]
PBS1	EQU	[0150H]
PCS0	EQU	[0151H]
PCS1	EQU	[0152H]
PDS0	EQU	[0153H]
PDS1	EQU	[0154H]
PES0	EQU	[0155H]
PES1	EQU	[0156H]
PFS0	EQU	[0157H]
PFS1	EQU	[0158H]
PGS0	EQU	[0159H]
PGS1	EQU	[015AH]
PHS0	EQU	[015BH]
PHS1	EQU	[015CH]

C	EQU	[0AH].0
AC	EQU	[0AH].1
Z	EQU	[0AH].2
OV	EQU	[0AH].3
PDF	EQU	[0AH].4
TO	EQU	[0AH].5
CZ	EQU	[0AH].6
SC	EQU	[0AH].7
PBP0	EQU	[0BH].0
PBP1	EQU	[0BH].1
PBP2	EQU	[0BH].2
WRF	EQU	[0FH].0
LRF	EQU	[0FH].1
LVRF	EQU	[0FH].2
RSTF	EQU	[0FH].3
EMI	EQU	[010H].0
INT0E	EQU	[010H].1
INT1E	EQU	[010H].2
CP0E	EQU	[010H].3
INT0F	EQU	[010H].4
INT1F	EQU	[010H].5
CP0F	EQU	[010H].6
CP1E	EQU	[011H].0
MF0E	EQU	[011H].1
MF1E	EQU	[011H].2
ADE	EQU	[011H].3
CP1F	EQU	[011H].4
MF0F	EQU	[011H].5
MF1F	EQU	[011H].6
ADF	EQU	[011H].7
MF2E	EQU	[012H].0
TB0E	EQU	[012H].1
TB1E	EQU	[012H].2
MF3E	EQU	[012H].3
MF2F	EQU	[012H].4
TB0F	EQU	[012H].5
TB1F	EQU	[012H].6
MF3F	EQU	[012H].7
INT2E	EQU	[013H].0
INT3E	EQU	[013H].1
MF4E	EQU	[013H].2
MF5E	EQU	[013H].3
INT2F	EQU	[013H].4
INT3F	EQU	[013H].5
MF4F	EQU	[013H].6
MF5F	EQU	[013H].7
PA0	EQU	[014H].0
PA1	EQU	[014H].1
PA2	EQU	[014H].2
PA3	EQU	[014H].3
PA4	EQU	[014H].4
PA5	EQU	[014H].5
PA6	EQU	[014H].6
PA7	EQU	[014H].7
PAC0	EQU	[015H].0
PAC1	EQU	[015H].1
PAC2	EQU	[015H].2
PAC3	EQU	[015H].3
PAC4	EQU	[015H].4
PAC5	EQU	[015H].5
PAC6	EQU	[015H].6
PAC7	EQU	[015H].7
PAPU0	EQU	[016H].0
PAPU1	EQU	[016H].1
PAPU2	EQU	[016H].2
PAPU3	EQU	[016H].3
PAPU4	EQU	[016H].4
PAPU5	EQU	[016H].5
PAPU6	EQU	[016H].6
PAPU7	EQU	[016H].7
PAWU0	EQU	[017H].0
PAWU1	EQU	[017H].1
PAWU2	EQU	[017H].2
PAWU3	EQU	[017H].3
PAWU4	EQU	[017H].4
PAWU5	EQU	[017H].5
PAWU6	EQU	[017H].6
PAWU7	EQU	[017H].7
PB0	EQU	[018H].0
PB1	EQU	[018H].1
PB2	EQU	[018H].2
PB3	EQU	[018H].3
PB4	EQU	[018H].4
PB5	EQU	[018H].5
PB6	EQU	[018H].6
PB7	EQU	[018H].7
PBC0	EQU	[019H].0
PBC1	EQU	[019H].1
PBC2	EQU	[019H].2
PBC3	EQU	[019H].3
PBC4	EQU	[019H].4
PBC5	EQU	[019H].5
PBC6	EQU	[019H].6
PBC7	EQU	[019H].7
PBPU0	EQU	[01AH].0
PBPU1	EQU	[01AH].1
PBPU2	EQU	[01AH].2
PBPU3	EQU	[01AH].3
PBPU4	EQU	[01AH].4
PBPU5	EQU	[01AH].5
PBPU6	EQU	[01AH].6
PBPU7	EQU	[01AH].7
PC0	EQU	[01BH].0
PC1	EQU	[01BH].1
PC2	EQU	[01BH].2
PC3	EQU	[01BH].3
PC4	EQU	[01BH].4
PC5	EQU	[01BH].5
PC6	EQU	[01BH].6
PC7	EQU	[01BH].7
PCC0	EQU	[01CH].0
PCC1	EQU	[01CH].1
PCC2	EQU	[01CH].2
PCC3	EQU	[01CH].3
PCC4	EQU	[01CH].4
PCC5	EQU	[01CH].5
PCC6	EQU	[01CH].6
PCC7	EQU	[01CH].7
PCPU0	EQU	[01DH].0
PCPU1	EQU	[01DH].1
PCPU2	EQU	[01DH].2
PCPU3	EQU	[01DH].3
PCPU4	EQU	[01DH].4
PCPU5	EQU	[01DH].5
PCPU6	EQU	[01DH].6
PCPU7	EQU	[01DH].7
PD0	EQU	[01EH].0
PD1	EQU	[01EH].1
PD2	EQU	[01EH].2
PD3	EQU	[01EH].3
PD4	EQU	[01EH].4
PD5	EQU	[01EH].5
PD6	EQU	[01EH].6
PDC0	EQU	[01FH].0
PDC1	EQU	[01FH].1
PDC2	EQU	[01FH].2
PDC3	EQU	[01FH].3
PDC4	EQU	[01FH].4
PDC5	EQU	[01FH].5
PDC6	EQU	[01FH].6
PDPU0	EQU	[020H].0
PDPU1	EQU	[020H].1
PDPU2	EQU	[020H].2
PDPU3	EQU	[020H].3
PDPU4	EQU	[020H].4
PDPU5	EQU	[020H].5
PDPU6	EQU	[020H].6
PE0	EQU	[021H].0
PE1	EQU	[021H].1
PE2	EQU	[021H].2
PE3	EQU	[021H].3
PE4	EQU	[021H].4
PEC0	EQU	[022H].0
PEC1	EQU	[022H].1
PEC2	EQU	[022H].2
PEC3	EQU	[022H].3
PEC4	EQU	[022H].4
PEPU0	EQU	[023H].0
PEPU1	EQU	[023H].1
PEPU2	EQU	[023H].2
PEPU3	EQU	[023H].3
PEPU4	EQU	[023H].4
PF0	EQU	[024H].0
PF1	EQU	[024H].1
PF2	EQU	[024H].2
PF3	EQU	[024H].3
PF4	EQU	[024H].4
PF5	EQU	[024H].5
PF6	EQU	[024H].6
PF7	EQU	[024H].7
PFC0	EQU	[025H].0
PFC1	EQU	[025H].1
PFC2	EQU	[025H].2
PFC3	EQU	[025H].3
PFC4	EQU	[025H].4
PFC5	EQU	[025H].5
PFC6	EQU	[025H].6
PFC7	EQU	[025H].7
PFPU0	EQU	[026H].0
PFPU1	EQU	[026H].1
PFPU2	EQU	[026H].2
PFPU3	EQU	[026H].3
PFPU4	EQU	[026H].4
PFPU5	EQU	[026H].5
PFPU6	EQU	[026H].6
PFPU7	EQU	[026H].7
PG0	EQU	[027H].0
PG1	EQU	[027H].1
PG2	EQU	[027H].2
PG3	EQU	[027H].3
PG4	EQU	[027H].4
PG5	EQU	[027H].5
PG6	EQU	[027H].6
PG7	EQU	[027H].7
PGC0	EQU	[028H].0
PGC1	EQU	[028H].1
PGC2	EQU	[028H].2
PGC3	EQU	[028H].3
PGC4	EQU	[028H].4
PGC5	EQU	[028H].5
PGC6	EQU	[028H].6
PGC7	EQU	[028H].7
PGPU0	EQU	[029H].0
PGPU1	EQU	[029H].1
PGPU2	EQU	[029H].2
PGPU3	EQU	[029H].3
PGPU4	EQU	[029H].4
PGPU5	EQU	[029H].5
PGPU6	EQU	[029H].6
PGPU7	EQU	[029H].7
PH0	EQU	[02AH].0
PH1	EQU	[02AH].1
PH2	EQU	[02AH].2
PH3	EQU	[02AH].3
PH4	EQU	[02AH].4
PH5	EQU	[02AH].5
PHC0	EQU	[02BH].0
PHC1	EQU	[02BH].1
PHC2	EQU	[02BH].2
PHC3	EQU	[02BH].3
PHC4	EQU	[02BH].4
PHC5	EQU	[02BH].5
PHPU0	EQU	[02CH].0
PHPU1	EQU	[02CH].1
PHPU2	EQU	[02CH].2
PHPU3	EQU	[02CH].3
PHPU4	EQU	[02CH].4
PHPU5	EQU	[02CH].5
PMPS0	EQU	[02DH].0
PMPS1	EQU	[02DH].1
RSTC0	EQU	[02EH].0
RSTC1	EQU	[02EH].1
RSTC2	EQU	[02EH].2
RSTC3	EQU	[02EH].3
RSTC4	EQU	[02EH].4
RSTC5	EQU	[02EH].5
RSTC6	EQU	[02EH].6
RSTC7	EQU	[02EH].7
VBGREN	EQU	[02FH].0
PTM0PE	EQU	[033H].0
PTM0AE	EQU	[033H].1
STM0PE	EQU	[033H].2
STM0AE	EQU	[033H].3
PTM0PF	EQU	[033H].4
PTM0AF	EQU	[033H].5
STM0PF	EQU	[033H].6
STM0AF	EQU	[033H].7
PTM1PE	EQU	[034H].0
PTM1AE	EQU	[034H].1
STM1PE	EQU	[034H].2
STM1AE	EQU	[034H].3
PTM1PF	EQU	[034H].4
PTM1AF	EQU	[034H].5
STM1PF	EQU	[034H].6
STM1AF	EQU	[034H].7
PTM2PE	EQU	[035H].0
PTM2AE	EQU	[035H].1
PTM2PF	EQU	[035H].4
PTM2AF	EQU	[035H].5
LVE	EQU	[036H].0
DEE	EQU	[036H].1
SPIAE	EQU	[036H].2
SIME	EQU	[036H].3
LVF	EQU	[036H].4
DEF	EQU	[036H].5
SPIAF	EQU	[036H].6
SIMF	EQU	[036H].7
PTM3PE	EQU	[037H].0
PTM3AE	EQU	[037H].1
STM2PE	EQU	[037H].2
STM2AE	EQU	[037H].3
PTM3PF	EQU	[037H].4
PTM3AF	EQU	[037H].5
STM2PF	EQU	[037H].6
STM2AF	EQU	[037H].7
UR0E	EQU	[038H].0
UR1E	EQU	[038H].1
UR2E	EQU	[038H].2
UR0F	EQU	[038H].4
UR1F	EQU	[038H].5
UR2F	EQU	[038H].6
INT0S0	EQU	[039H].0
INT0S1	EQU	[039H].1
INT1S0	EQU	[039H].2
INT1S1	EQU	[039H].3
INT2S0	EQU	[039H].4
INT2S1	EQU	[039H].5
INT3S0	EQU	[039H].6
INT3S1	EQU	[039H].7
FSIDEN	EQU	[03AH].0
FHIDEN	EQU	[03AH].1
FSS	EQU	[03AH].2
FHS	EQU	[03AH].3
CKS0	EQU	[03AH].5
CKS1	EQU	[03AH].6
CKS2	EQU	[03AH].7
HIRCEN	EQU	[03BH].0
HIRCF	EQU	[03BH].1
HIRC0	EQU	[03BH].2
HIRC1	EQU	[03BH].3
HXTEN	EQU	[03CH].0
HXTF	EQU	[03CH].1
HXTM	EQU	[03CH].2
LXTEN	EQU	[03DH].0
LXTF	EQU	[03DH].1
WS0	EQU	[03EH].0
WS1	EQU	[03EH].1
WS2	EQU	[03EH].2
WE0	EQU	[03EH].3
WE1	EQU	[03EH].4
WE2	EQU	[03EH].5
WE3	EQU	[03EH].6
WE4	EQU	[03EH].7
LVS0	EQU	[03FH].0
LVS1	EQU	[03FH].1
LVS2	EQU	[03FH].2
LVS3	EQU	[03FH].3
LVS4	EQU	[03FH].4
LVS5	EQU	[03FH].5
LVS6	EQU	[03FH].6
LVS7	EQU	[03FH].7
VLVD0	EQU	[040H].0
VLVD1	EQU	[040H].1
VLVD2	EQU	[040H].2
VBGEN	EQU	[040H].3
LVDEN	EQU	[040H].4
LVDO	EQU	[040H].5
EEAL0	EQU	[041H].0
EEAL1	EQU	[041H].1
EEAL2	EQU	[041H].2
EEAL3	EQU	[041H].3
EEAL4	EQU	[041H].4
EEAL5	EQU	[041H].5
EEAL6	EQU	[041H].6
EEAL7	EQU	[041H].7
EEAH0	EQU	[042H].0
EEAH1	EQU	[042H].1
CNVT00	EQU	[044H].2
CNVT01	EQU	[044H].3
C0OUT	EQU	[044H].4
C0POL	EQU	[044H].5
C0EN	EQU	[044H].6
CNVT10	EQU	[045H].2
CNVT11	EQU	[045H].3
C1OUT	EQU	[045H].4
C1POL	EQU	[045H].5
C1EN	EQU	[045H].6
PT0ON	EQU	[046H].3
PT0CK0	EQU	[046H].4
PT0CK1	EQU	[046H].5
PT0CK2	EQU	[046H].6
PT0PAU	EQU	[046H].7
PT0CCLR	EQU	[047H].0
PT0CAPTS	EQU	[047H].1
PT0POL	EQU	[047H].2
PT0OC	EQU	[047H].3
PT0IO0	EQU	[047H].4
PT0IO1	EQU	[047H].5
PT0M0	EQU	[047H].6
PT0M1	EQU	[047H].7
PT0RP0	EQU	[04CH].0
PT0RP1	EQU	[04CH].1
PT0RP2	EQU	[04CH].2
PT0RP3	EQU	[04CH].3
PT0RP4	EQU	[04CH].4
PT0RP5	EQU	[04CH].5
PT0RP6	EQU	[04CH].6
PT0RP7	EQU	[04CH].7
PT0RP8	EQU	[04DH].0
PT0RP9	EQU	[04DH].1
ST0ON	EQU	[04EH].3
ST0CK0	EQU	[04EH].4
ST0CK1	EQU	[04EH].5
ST0CK2	EQU	[04EH].6
ST0PAU	EQU	[04EH].7
ST0CCLR	EQU	[04FH].0
ST0DPX	EQU	[04FH].1
ST0POL	EQU	[04FH].2
ST0OC	EQU	[04FH].3
ST0IO0	EQU	[04FH].4
ST0IO1	EQU	[04FH].5
ST0M0	EQU	[04FH].6
ST0M1	EQU	[04FH].7
ST0RP0	EQU	[054H].0
ST0RP1	EQU	[054H].1
ST0RP2	EQU	[054H].2
ST0RP3	EQU	[054H].3
ST0RP4	EQU	[054H].4
ST0RP5	EQU	[054H].5
ST0RP6	EQU	[054H].6
ST0RP7	EQU	[054H].7
SLEDC00	EQU	[055H].0
SLEDC01	EQU	[055H].1
SLEDC02	EQU	[055H].2
SLEDC03	EQU	[055H].3
SLEDC04	EQU	[055H].4
SLEDC05	EQU	[055H].5
SLEDC06	EQU	[055H].6
SLEDC07	EQU	[055H].7
SLEDC10	EQU	[056H].0
SLEDC11	EQU	[056H].1
SLEDC12	EQU	[056H].2
SLEDC13	EQU	[056H].3
SLEDC14	EQU	[056H].4
SLEDC15	EQU	[056H].5
SLEDC16	EQU	[056H].6
SLEDC17	EQU	[056H].7
SLEDC20	EQU	[057H].0
SLEDC21	EQU	[057H].1
SLEDC22	EQU	[057H].2
SLEDC23	EQU	[057H].3
SLEDC24	EQU	[057H].4
SLEDC25	EQU	[057H].5
SLEDC26	EQU	[057H].6
SLEDC27	EQU	[057H].7
SLEDC30	EQU	[058H].0
SLEDC31	EQU	[058H].1
SLEDC32	EQU	[058H].2
SLEDC33	EQU	[058H].3
SLEDC34	EQU	[058H].4
SLEDC35	EQU	[058H].5
SLEDC36	EQU	[058H].6
SLEDC37	EQU	[058H].7
MDWOV	EQU	[05FH].6
MDWEF	EQU	[05FH].7
C0OF0	EQU	[060H].0
C0OF1	EQU	[060H].1
C0OF2	EQU	[060H].2
C0OF3	EQU	[060H].3
C0OF4	EQU	[060H].4
C0RSP	EQU	[060H].5
C0OFM	EQU	[060H].6
C1OF0	EQU	[061H].0
C1OF1	EQU	[061H].1
C1OF2	EQU	[061H].2
C1OF3	EQU	[061H].3
C1OF4	EQU	[061H].4
C1RSP	EQU	[061H].5
C1OFM	EQU	[061H].6
CLKSEL00	EQU	[063H].0
CLKSEL01	EQU	[063H].1
TB00	EQU	[064H].0
TB01	EQU	[064H].1
TB02	EQU	[064H].2
TB0ON	EQU	[064H].7
TB10	EQU	[065H].0
TB11	EQU	[065H].1
TB12	EQU	[065H].2
TB1ON	EQU	[065H].7
CLKSEL10	EQU	[066H].0
CLKSEL11	EQU	[066H].1
SACS0	EQU	[069H].0
SACS1	EQU	[069H].1
SACS2	EQU	[069H].2
SACS3	EQU	[069H].3
ADRFS	EQU	[069H].4
ADCEN	EQU	[069H].5
ADBZ	EQU	[069H].6
START	EQU	[069H].7
SACKS0	EQU	[06AH].0
SACKS1	EQU	[06AH].1
SACKS2	EQU	[06AH].2
SAINS0	EQU	[06AH].4
SAINS1	EQU	[06AH].5
SAINS2	EQU	[06AH].6
SAINS3	EQU	[06AH].7
PGAGS0	EQU	[06BH].0
PGAGS1	EQU	[06BH].1
SAVRS0	EQU	[06BH].2
SAVRS1	EQU	[06BH].3
PGAIS	EQU	[06BH].4
ADPGAEN	EQU	[06BH].7
SIMICF	EQU	[06CH].0
SIMEN	EQU	[06CH].1
SIMDEB0	EQU	[06CH].2
SIMDEB1	EQU	[06CH].3
SIM0	EQU	[06CH].5
SIM1	EQU	[06CH].6
SIM2	EQU	[06CH].7
RXAK	EQU	[06DH].0
IAMWU	EQU	[06DH].1
SRW	EQU	[06DH].2
TXAK	EQU	[06DH].3
HTX	EQU	[06DH].4
HBB	EQU	[06DH].5
HAAS	EQU	[06DH].6
HCF	EQU	[06DH].7
TRF	EQU	[06FH].0
WCOL	EQU	[06FH].1
CSEN	EQU	[06FH].2
MLS	EQU	[06FH].3
CKEG	EQU	[06FH].4
CKPOLB	EQU	[06FH].5
IICA0	EQU	[06FH].1
IICA1	EQU	[06FH].2
IICA2	EQU	[06FH].3
IICA3	EQU	[06FH].4
IICA4	EQU	[06FH].5
IICA5	EQU	[06FH].6
IICA6	EQU	[06FH].7
SIMTOS0	EQU	[070H].0
SIMTOS1	EQU	[070H].1
SIMTOS2	EQU	[070H].2
SIMTOS3	EQU	[070H].3
SIMTOS4	EQU	[070H].4
SIMTOS5	EQU	[070H].5
SIMTOF	EQU	[070H].6
SIMTOEN	EQU	[070H].7
SPIAICF	EQU	[071H].0
SPIAEN	EQU	[071H].1
SASPI0	EQU	[071H].5
SASPI1	EQU	[071H].6
SASPI2	EQU	[071H].7
SATRF	EQU	[072H].0
SAWCOL	EQU	[072H].1
SACSEN	EQU	[072H].2
SAMLS	EQU	[072H].3
SACKEG	EQU	[072H].4
SACKPOLB	EQU	[072H].5
A0	EQU	[074H].0
A1	EQU	[074H].1
A2	EQU	[074H].2
A3	EQU	[074H].3
A4	EQU	[074H].4
A5	EQU	[074H].5
A6	EQU	[074H].6
A7	EQU	[074H].7
A8	EQU	[075H].0
A9	EQU	[075H].1
A10	EQU	[075H].2
A11	EQU	[075H].3
A12	EQU	[075H].4
A13	EQU	[075H].5
A14	EQU	[075H].6
A15	EQU	[075H].7
SCOMEN	EQU	[07FH].4
ISEL0	EQU	[07FH].5
ISEL1	EQU	[07FH].6
POLY	EQU	[0100H].0
IECS0	EQU	[0106H].0
IECS1	EQU	[0106H].1
IECS2	EQU	[0106H].2
IECS3	EQU	[0106H].3
IECS4	EQU	[0106H].4
IECS5	EQU	[0106H].5
IECS6	EQU	[0106H].6
IECS7	EQU	[0106H].7
TXIF2	EQU	[010BH].0
TIDLE2	EQU	[010BH].1
RXIF2	EQU	[010BH].2
RIDLE2	EQU	[010BH].3
OERR2	EQU	[010BH].4
FERR2	EQU	[010BH].5
NF2	EQU	[010BH].6
PERR2	EQU	[010BH].7
TX82	EQU	[010CH].0
RX82	EQU	[010CH].1
TXBRK2	EQU	[010CH].2
STOPS2	EQU	[010CH].3
PRT2	EQU	[010CH].4
PREN2	EQU	[010CH].5
BNO2	EQU	[010CH].6
UARTEN2	EQU	[010CH].7
TEIE2	EQU	[010DH].0
TIIE2	EQU	[010DH].1
RIE2	EQU	[010DH].2
WAKE2	EQU	[010DH].3
ADDEN2	EQU	[010DH].4
BRGH2	EQU	[010DH].5
RXEN2	EQU	[010DH].6
TXEN2	EQU	[010DH].7
TXIF0	EQU	[0110H].0
TIDLE0	EQU	[0110H].1
RXIF0	EQU	[0110H].2
RIDLE0	EQU	[0110H].3
OERR0	EQU	[0110H].4
FERR0	EQU	[0110H].5
NF0	EQU	[0110H].6
PERR0	EQU	[0110H].7
TX80	EQU	[0111H].0
RX80	EQU	[0111H].1
TXBRK0	EQU	[0111H].2
STOPS0	EQU	[0111H].3
PRT0	EQU	[0111H].4
PREN0	EQU	[0111H].5
BNO0	EQU	[0111H].6
UARTEN0	EQU	[0111H].7
TEIE0	EQU	[0112H].0
TIIE0	EQU	[0112H].1
RIE0	EQU	[0112H].2
WAKE0	EQU	[0112H].3
ADDEN0	EQU	[0112H].4
BRGH0	EQU	[0112H].5
RXEN0	EQU	[0112H].6
TXEN0	EQU	[0112H].7
TXIF1	EQU	[0115H].0
TIDLE1	EQU	[0115H].1
RXIF1	EQU	[0115H].2
RIDLE1	EQU	[0115H].3
OERR1	EQU	[0115H].4
FERR1	EQU	[0115H].5
NF1	EQU	[0115H].6
PERR1	EQU	[0115H].7
TX81	EQU	[0116H].0
RX81	EQU	[0116H].1
TXBRK1	EQU	[0116H].2
STOPS1	EQU	[0116H].3
PRT1	EQU	[0116H].4
PREN1	EQU	[0116H].5
BNO1	EQU	[0116H].6
UARTEN1	EQU	[0116H].7
TEIE1	EQU	[0117H].0
TIIE1	EQU	[0117H].1
RIE1	EQU	[0117H].2
WAKE1	EQU	[0117H].3
ADDEN1	EQU	[0117H].4
BRGH1	EQU	[0117H].5
RXEN1	EQU	[0117H].6
TXEN1	EQU	[0117H].7
PT1ON	EQU	[011AH].3
PT1CK0	EQU	[011AH].4
PT1CK1	EQU	[011AH].5
PT1CK2	EQU	[011AH].6
PT1PAU	EQU	[011AH].7
PT1CCLR	EQU	[011BH].0
PT1CAPTS	EQU	[011BH].1
PT1POL	EQU	[011BH].2
PT1OC	EQU	[011BH].3
PT1IO0	EQU	[011BH].4
PT1IO1	EQU	[011BH].5
PT1M0	EQU	[011BH].6
PT1M1	EQU	[011BH].7
PT1RP0	EQU	[0120H].0
PT1RP1	EQU	[0120H].1
PT1RP2	EQU	[0120H].2
PT1RP3	EQU	[0120H].3
PT1RP4	EQU	[0120H].4
PT1RP5	EQU	[0120H].5
PT1RP6	EQU	[0120H].6
PT1RP7	EQU	[0120H].7
PT1RP8	EQU	[0121H].0
PT1RP9	EQU	[0121H].1
PT2ON	EQU	[0122H].3
PT2CK0	EQU	[0122H].4
PT2CK1	EQU	[0122H].5
PT2CK2	EQU	[0122H].6
PT2PAU	EQU	[0122H].7
PT2CCLR	EQU	[0123H].0
PT2CAPTS	EQU	[0123H].1
PT2POL	EQU	[0123H].2
PT2OC	EQU	[0123H].3
PT2IO0	EQU	[0123H].4
PT2IO1	EQU	[0123H].5
PT2M0	EQU	[0123H].6
PT2M1	EQU	[0123H].7
PT2RP0	EQU	[0128H].0
PT2RP1	EQU	[0128H].1
PT2RP2	EQU	[0128H].2
PT2RP3	EQU	[0128H].3
PT2RP4	EQU	[0128H].4
PT2RP5	EQU	[0128H].5
PT2RP6	EQU	[0128H].6
PT2RP7	EQU	[0128H].7
PT2RP8	EQU	[0129H].0
PT2RP9	EQU	[0129H].1
PT2RP10	EQU	[0129H].2
PT2RP11	EQU	[0129H].3
PT2RP12	EQU	[0129H].4
PT2RP13	EQU	[0129H].5
PT2RP14	EQU	[0129H].6
PT2RP15	EQU	[0129H].7
PT3ON	EQU	[012AH].3
PT3CK0	EQU	[012AH].4
PT3CK1	EQU	[012AH].5
PT3CK2	EQU	[012AH].6
PT3PAU	EQU	[012AH].7
PT3CCLR	EQU	[012BH].0
PT3CAPTS	EQU	[012BH].1
PT3POL	EQU	[012BH].2
PT3OC	EQU	[012BH].3
PT3IO0	EQU	[012BH].4
PT3IO1	EQU	[012BH].5
PT3M0	EQU	[012BH].6
PT3M1	EQU	[012BH].7
PT3RP0	EQU	[0130H].0
PT3RP1	EQU	[0130H].1
PT3RP2	EQU	[0130H].2
PT3RP3	EQU	[0130H].3
PT3RP4	EQU	[0130H].4
PT3RP5	EQU	[0130H].5
PT3RP6	EQU	[0130H].6
PT3RP7	EQU	[0130H].7
PT3RP8	EQU	[0131H].0
PT3RP9	EQU	[0131H].1
PT3RP10	EQU	[0131H].2
PT3RP11	EQU	[0131H].3
PT3RP12	EQU	[0131H].4
PT3RP13	EQU	[0131H].5
PT3RP14	EQU	[0131H].6
PT3RP15	EQU	[0131H].7
ST1ON	EQU	[0132H].3
ST1CK0	EQU	[0132H].4
ST1CK1	EQU	[0132H].5
ST1CK2	EQU	[0132H].6
ST1PAU	EQU	[0132H].7
ST1CCLR	EQU	[0133H].0
ST1DPX	EQU	[0133H].1
ST1POL	EQU	[0133H].2
ST1OC	EQU	[0133H].3
ST1IO0	EQU	[0133H].4
ST1IO1	EQU	[0133H].5
ST1M0	EQU	[0133H].6
ST1M1	EQU	[0133H].7
ST1RP0	EQU	[0138H].0
ST1RP1	EQU	[0138H].1
ST1RP2	EQU	[0138H].2
ST1RP3	EQU	[0138H].3
ST1RP4	EQU	[0138H].4
ST1RP5	EQU	[0138H].5
ST1RP6	EQU	[0138H].6
ST1RP7	EQU	[0138H].7
ST2ON	EQU	[0139H].3
ST2CK0	EQU	[0139H].4
ST2CK1	EQU	[0139H].5
ST2CK2	EQU	[0139H].6
ST2PAU	EQU	[0139H].7
ST2CCLR	EQU	[013AH].0
ST2DPX	EQU	[013AH].1
ST2POL	EQU	[013AH].2
ST2OC	EQU	[013AH].3
ST2IO0	EQU	[013AH].4
ST2IO1	EQU	[013AH].5
ST2M0	EQU	[013AH].6
ST2M1	EQU	[013AH].7
ST2RP0	EQU	[013FH].0
ST2RP1	EQU	[013FH].1
ST2RP2	EQU	[013FH].2
ST2RP3	EQU	[013FH].3
ST2RP4	EQU	[013FH].4
ST2RP5	EQU	[013FH].5
ST2RP6	EQU	[013FH].6
ST2RP7	EQU	[013FH].7
RD	EQU	[0140H].0
RDEN	EQU	[0140H].1
WR	EQU	[0140H].2
WREN	EQU	[0140H].3
FRD	EQU	[0143H].0
FRDEN	EQU	[0143H].1
FWT	EQU	[0143H].2
FWPEN	EQU	[0143H].3
FMOD0	EQU	[0143H].4
FMOD1	EQU	[0143H].5
FMOD2	EQU	[0143H].6
CFWEN	EQU	[0143H].7
CLWB	EQU	[0145H].0
STCK0PS	EQU	[0148H].0
STCK1PS	EQU	[0148H].1
STCK2PS	EQU	[0148H].2
PTCK0PS	EQU	[0148H].3
PTCK1PS	EQU	[0148H].4
PTCK2PS	EQU	[0148H].5
PTCK3PS	EQU	[0148H].6
STP0IPS	EQU	[0149H].0
STP1IPS	EQU	[0149H].1
STP2IPS	EQU	[0149H].2
PTP0IPS	EQU	[0149H].3
PTP1IPS	EQU	[0149H].4
PTP2IPS	EQU	[0149H].5
PTP3IPS	EQU	[0149H].6
INT0PS	EQU	[014AH].0
INT1PS	EQU	[014AH].1
INT2PS	EQU	[014AH].2
INT3PS	EQU	[014AH].3
SCKSCLPS	EQU	[014AH].4
SDISDAPS	EQU	[014AH].5
SCSBPS	EQU	[014AH].6
RX0PS	EQU	[014BH].0
RX1PS	EQU	[014BH].1
RX2PS	EQU	[014BH].2
PAS00	EQU	[014DH].0
PAS01	EQU	[014DH].1
PAS02	EQU	[014DH].2
PAS03	EQU	[014DH].3
PAS04	EQU	[014DH].4
PAS05	EQU	[014DH].5
PAS06	EQU	[014DH].6
PAS07	EQU	[014DH].7
PAS10	EQU	[014EH].0
PAS11	EQU	[014EH].1
PAS12	EQU	[014EH].2
PAS13	EQU	[014EH].3
PAS14	EQU	[014EH].4
PAS15	EQU	[014EH].5
PAS16	EQU	[014EH].6
PAS17	EQU	[014EH].7
PBS00	EQU	[014FH].0
PBS01	EQU	[014FH].1
PBS02	EQU	[014FH].2
PBS03	EQU	[014FH].3
PBS04	EQU	[014FH].4
PBS05	EQU	[014FH].5
PBS06	EQU	[014FH].6
PBS07	EQU	[014FH].7
PBS10	EQU	[0150H].0
PBS11	EQU	[0150H].1
PBS12	EQU	[0150H].2
PBS13	EQU	[0150H].3
PBS14	EQU	[0150H].4
PBS15	EQU	[0150H].5
PBS16	EQU	[0150H].6
PBS17	EQU	[0150H].7
PCS00	EQU	[0151H].0
PCS01	EQU	[0151H].1
PCS02	EQU	[0151H].2
PCS03	EQU	[0151H].3
PCS04	EQU	[0151H].4
PCS05	EQU	[0151H].5
PCS06	EQU	[0151H].6
PCS07	EQU	[0151H].7
PCS10	EQU	[0152H].0
PCS11	EQU	[0152H].1
PCS12	EQU	[0152H].2
PCS13	EQU	[0152H].3
PCS14	EQU	[0152H].4
PCS15	EQU	[0152H].5
PCS16	EQU	[0152H].6
PCS17	EQU	[0152H].7
PDS00	EQU	[0153H].0
PDS01	EQU	[0153H].1
PDS02	EQU	[0153H].2
PDS03	EQU	[0153H].3
PDS04	EQU	[0153H].4
PDS05	EQU	[0153H].5
PDS06	EQU	[0153H].6
PDS07	EQU	[0153H].7
PDS10	EQU	[0154H].0
PDS11	EQU	[0154H].1
PDS12	EQU	[0154H].2
PDS13	EQU	[0154H].3
PDS14	EQU	[0154H].4
PDS15	EQU	[0154H].5
PES00	EQU	[0155H].0
PES01	EQU	[0155H].1
PES02	EQU	[0155H].2
PES03	EQU	[0155H].3
PES04	EQU	[0155H].4
PES05	EQU	[0155H].5
PES06	EQU	[0155H].6
PES07	EQU	[0155H].7
PES10	EQU	[0156H].0
PES11	EQU	[0156H].1
PFS00	EQU	[0157H].0
PFS01	EQU	[0157H].1
PFS02	EQU	[0157H].2
PFS03	EQU	[0157H].3
PFS04	EQU	[0157H].4
PFS05	EQU	[0157H].5
PFS06	EQU	[0157H].6
PFS07	EQU	[0157H].7
PFS10	EQU	[0158H].0
PFS11	EQU	[0158H].1
PFS12	EQU	[0158H].2
PFS13	EQU	[0158H].3
PFS14	EQU	[0158H].4
PFS15	EQU	[0158H].5
PFS16	EQU	[0158H].6
PFS17	EQU	[0158H].7
PGS00	EQU	[0159H].0
PGS01	EQU	[0159H].1
PGS02	EQU	[0159H].2
PGS03	EQU	[0159H].3
PGS04	EQU	[0159H].4
PGS05	EQU	[0159H].5
PGS06	EQU	[0159H].6
PGS07	EQU	[0159H].7
PGS10	EQU	[015AH].0
PGS11	EQU	[015AH].1
PGS12	EQU	[015AH].2
PGS13	EQU	[015AH].3
PGS14	EQU	[015AH].4
PGS15	EQU	[015AH].5
PGS16	EQU	[015AH].6
PGS17	EQU	[015AH].7
PHS00	EQU	[015BH].0
PHS01	EQU	[015BH].1
PHS02	EQU	[015BH].2
PHS03	EQU	[015BH].3
PHS04	EQU	[015BH].4
PHS05	EQU	[015BH].5
PHS06	EQU	[015BH].6
PHS07	EQU	[015BH].7
PHS10	EQU	[015CH].0
PHS11	EQU	[015CH].1
PHS12	EQU	[015CH].2
PHS13	EQU	[015CH].3

